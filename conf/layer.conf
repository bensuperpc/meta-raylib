## conf/layer.conf
```bitbake
# We have a conf and classes directory, add to BBPATH
BBPATH .= ":${LAYERDIR}"

# We have recipes-* directories, add to BBFILES
BBFILES += "${LAYERDIR}/recipes-*/*/*.bb \
            ${LAYERDIR}/recipes-*/*/*.bbappend"

BBFILE_COLLECTIONS += "meta-raylib"
BBFILE_PATTERN_meta-raylib = "^${LAYERDIR}/"
BBFILE_PRIORITY_meta-raylib = "12"

LAYERDEPENDS_meta-raylib = "core"
LAYERSERIES_COMPAT_meta-raylib = "dunfell kirkstone scarthgap mickledore"
LAYERVERSION_meta-raylib = "1"
# LICENSE_PATH += "${LAYERDIR}/licenses"
```
